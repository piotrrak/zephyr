## boards/renesas/ek_ra8m1/Kconfig.ek_ra8m1
```kconfig
# Copyright (c) 2024 Piotr Rak <piotr.rak@gmail.com>
# SPDX-License-Identifier: Apache-2.0

config BOARD_EK_RA8M1
	select SOC_R7FA8M1AHECBD
```

## cmake/toolchain/llvmarmemb/Kconfig
```kconfig
# LLVM Embedded Toolchain for Arm
#
# See https://github.com/ARM-software/LLVM-embedded-toolchain-for-Arm

# Copyright (c) 2024 Piotr Rak
# SPDX-License-Identifier: Apache-2.0

config TOOLCHAIN_LLVMARMEMB
	def_bool y
	select BUILD_NO_GAP_FILL
```
