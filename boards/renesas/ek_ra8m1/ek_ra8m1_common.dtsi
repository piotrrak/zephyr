/*
 * Copyright (c) 2024 Piotr Rak <piotr.rak@gmail.com>
 *
 * SPDX-License-Identifier: Apache-2.0
 */

/dts-v1/;
#include <renesas/ra/r7fa8m1ahecbd.dtsi>

/ {
	model = "Renesas EK-RA8M1 Board";
	compatible = "renesas,r7fa8m1ahecbd";
};
